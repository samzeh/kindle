#include "epd.h"
#include "board_config.h"
#include "soc/gpio_reg.h"

static const uint32_t BUSY_TIMEOUT_MS = 10000;

// ---- Software SPI ----
// Same signal sequence as the vendor demo, but the pins are switched by
// writing the ESP32's GPIO registers directly: digitalWrite() is slow
// enough that sending one page took ~1.4 s.

static_assert(PIN_EPD_SCK < 32 && PIN_EPD_MOSI < 32 && PIN_EPD_CS < 32 && PIN_EPD_DC < 32,
              "fast pin writes below only handle GPIO 0-31");

static inline void pinHigh(uint8_t pin) {
  REG_WRITE(GPIO_OUT_W1TS_REG, 1UL << pin);
}

static inline void pinLow(uint8_t pin) {
  REG_WRITE(GPIO_OUT_W1TC_REG, 1UL << pin);
}

static void spiWrite(uint8_t value) {
  for (uint8_t i = 0; i < 8; i++) {
    pinLow(PIN_EPD_SCK);
    if (value & 0x80) pinHigh(PIN_EPD_MOSI);
    else pinLow(PIN_EPD_MOSI);
    value <<= 1;
    pinHigh(PIN_EPD_SCK);
  }
}

static void writeCommand(uint8_t command) {
  pinLow(PIN_EPD_CS);
  pinLow(PIN_EPD_DC);
  spiWrite(command);
  pinHigh(PIN_EPD_CS);
}

static void writeData(uint8_t data) {
  pinLow(PIN_EPD_CS);
  pinHigh(PIN_EPD_DC);
  spiWrite(data);
  pinHigh(PIN_EPD_CS);
}

// CS is toggled for every byte, as in the vendor demo.
static void writeImage(uint8_t ramCommand, const uint8_t *image) {
  const uint16_t rowBytes = EPD_NATIVE_WIDTH / 8;
  writeCommand(ramCommand);
  for (uint16_t r = 0; r < EPD_NATIVE_HEIGHT; r++) {
    uint16_t row = EPD_FLIP_ROWS ? EPD_NATIVE_HEIGHT - 1 - r : r;
    for (uint16_t b = 0; b < rowBytes; b++) writeData(image[row * rowBytes + b]);
  }
}

// The data line doubles as input for reads (3-wire SPI).
static uint8_t readData() {
  uint8_t value = 0;
  pinMode(PIN_EPD_MOSI, INPUT);
  digitalWrite(PIN_EPD_CS, LOW);
  digitalWrite(PIN_EPD_DC, HIGH);
  for (uint8_t i = 0; i < 8; i++) {
    digitalWrite(PIN_EPD_SCK, LOW);
    delayMicroseconds(1);
    value = (value << 1) | digitalRead(PIN_EPD_MOSI);
    digitalWrite(PIN_EPD_SCK, HIGH);
    delayMicroseconds(1);
  }
  digitalWrite(PIN_EPD_CS, HIGH);
  pinMode(PIN_EPD_MOSI, OUTPUT);
  return value;
}

static void waitWhileBusy(const char *what) {
  uint32_t start = millis();
  while (digitalRead(PIN_EPD_BUSY) == HIGH) {
    if (millis() - start > BUSY_TIMEOUT_MS) {
      Serial.printf("epd: timed out waiting for %s\n", what);
      return;
    }
    delay(1);
  }
}

// ---- Waveforms (from the vendor demo) ----
// Each table: 105 bytes of LUT, then gate voltage, 3 source voltages, VCOM.
// The full-refresh waveform is picked by panel temperature.

static const uint8_t LUT_0_5[110] = {
  0xAA, 0x48, 0x55, 0x44, 0x00, 0x00, 0x00, 0x00, 0x00, 0x00,
  0x55, 0x48, 0xAA, 0x88, 0x00, 0x00, 0x00, 0x00, 0x00, 0x00,
  0xAA, 0x48, 0x55, 0x44, 0x00, 0x00, 0x00, 0x00, 0x00, 0x00,
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  0x17, 0x41, 0xA8, 0x32, 0x48,
};

static const uint8_t LUT_5_10[110] = {
  0xAA, 0x48, 0x55, 0x44, 0x00, 0x00, 0x00, 0x00, 0x00, 0x00,
  0x55, 0x48, 0xAA, 0x88, 0x00, 0x00, 0x00, 0x00, 0x00, 0x00,
  0xAA, 0x48, 0x55, 0x44, 0x00, 0x00, 0x00, 0x00, 0x00, 0x00,
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  0x17, 0x41, 0xA8, 0x32, 0x48,
};

static const uint8_t LUT_10_15[110] = {
  0xAA, 0x48, 0x55, 0x44, 0x00, 0x00, 0x00, 0x00, 0x00, 0x00,
  0x55, 0x48, 0xAA, 0x88, 0x00, 0x00, 0x00, 0x00, 0x00, 0x00,
  0xAA, 0x48, 0x55, 0x44, 0x00, 0x00, 0x00, 0x00, 0x00, 0x00,
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  0x17, 0x41, 0xA8, 0x32, 0x48,
};

static const uint8_t LUT_15_20[110] = {
  0xA2, 0x48, 0x51, 0x00, 0x00, 0x00, 0x00, 0x00, 0x00, 0x00,
  0x54, 0x48, 0xA8, 0x80, 0x00, 0x00, 0x00, 0x00, 0x00, 0x00,
  0xA2, 0x48, 0x51, 0x00, 0x00, 0x00, 0x00, 0x00, 0x00, 0x00,
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  0x17, 0x41, 0xA8, 0x32, 0x48,
};

static const uint8_t LUT_20_80[110] = {
  0xA0, 0x48, 0x54, 0x00, 0x00, 0x00, 0x00, 0x00, 0x00, 0x00,
  0x50, 0x48, 0xA8, 0x00, 0x00, 0x00, 0x00, 0x00, 0x00, 0x00,
  0xA0, 0x48, 0x54, 0x00, 0x00, 0x00, 0x00, 0x00, 0x00, 0x00,
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  0x17, 0x41, 0xA8, 0x32, 0x48,
};

static int readTemperature() {
  writeCommand(0x18);  // use the internal temperature sensor
  writeData(0x80);
  writeCommand(0x22);  // measure temperature
  writeData(0xB1);
  writeCommand(0x20);
  waitWhileBusy("temperature");

  writeCommand(0x1B);  // read temperature register (12 bits, 1/16 degree C)
  uint8_t high = readData();
  uint8_t low = readData();
  return (((high << 8) | low) >> 4) / 16;
}

static void writeLut(const uint8_t *lut) {
  writeCommand(0x32);  // waveform
  for (uint8_t i = 0; i < 105; i++) writeData(lut[i]);
  waitWhileBusy("LUT");
  writeCommand(0x03);  // gate voltage
  writeData(lut[105]);
  writeCommand(0x04);  // source voltages
  writeData(lut[106]);
  writeData(lut[107]);
  writeData(lut[108]);
  writeCommand(0x2C);  // VCOM
  writeData(lut[109]);
}

// ---- Panel setup ----

static void hardwareReset() {
  digitalWrite(PIN_EPD_RST, LOW);
  delay(10);
  digitalWrite(PIN_EPD_RST, HIGH);
  delay(10);
}

// Full-screen RAM window, address counters at the origin.
static void setFullWindow() {
  writeCommand(0x11);  // data entry mode: x then y increasing
  writeData(0x03);
  writeCommand(0x44);  // x (source) range 0..799
  writeData(0x00);
  writeData(0x00);
  writeData((EPD_NATIVE_WIDTH - 1) % 256);
  writeData((EPD_NATIVE_WIDTH - 1) / 256);
  writeCommand(0x45);  // y (gate) range 0..479
  writeData(0x00);
  writeData(0x00);
  writeData((EPD_NATIVE_HEIGHT - 1) % 256);
  writeData((EPD_NATIVE_HEIGHT - 1) / 256);
  writeCommand(0x4E);  // x counter
  writeData(0x00);
  writeData(0x00);
  writeCommand(0x4F);  // y counter
  writeData(0x00);
  writeData(0x00);
}

static void initController() {
  hardwareReset();
  waitWhileBusy("reset");
  writeCommand(0x12);  // software reset
  waitWhileBusy("software reset");

  writeCommand(0x18);  // internal temperature sensor
  writeData(0x80);
  writeCommand(0x0C);  // booster soft start
  writeData(0xAE);
  writeData(0xC7);
  writeData(0xC3);
  writeData(0xC0);
  writeData(0x80);
  writeCommand(0x01);  // driver output: 480 gates
  writeData((EPD_NATIVE_HEIGHT - 1) % 256);
  writeData((EPD_NATIVE_HEIGHT - 1) / 256);
  writeData(0x02);
  writeCommand(0x3C);  // border waveform
  writeData(0x01);
  setFullWindow();
  waitWhileBusy("init");
}

// ---- Public API ----

void epdBegin() {
  // Keep this exactly like the vendor demo: CS and SCK stay low (the default
  // after pinMode) until the first command. Setting them high here made the
  // panel ignore every command on most boots; the exact reason is unknown.
  pinMode(PIN_EPD_BUSY, INPUT);
  pinMode(PIN_EPD_RST, OUTPUT);
  pinMode(PIN_EPD_DC, OUTPUT);
  pinMode(PIN_EPD_CS, OUTPUT);
  pinMode(PIN_EPD_MOSI, OUTPUT);
  pinMode(PIN_EPD_SCK, OUTPUT);
}

void epdShowFull(const uint8_t *image) {
  initController();
  // Both RAMs get the image: 0x24 is what to show, 0x26 is what the next
  // partial refresh will compare against.
  writeImage(0x24, image);
  setFullWindow();
  writeImage(0x26, image);

  int temp = readTemperature();
  if (temp <= 5) writeLut(LUT_0_5);
  else if (temp <= 10) writeLut(LUT_5_10);
  else if (temp <= 15) writeLut(LUT_10_15);
  else if (temp <= 20) writeLut(LUT_15_20);
  else writeLut(LUT_20_80);

  writeCommand(0x22);  // display update using the loaded waveform
  writeData(0xC7);
  writeCommand(0x20);
  uint32_t start = millis();
  waitWhileBusy("full refresh");
  // A temperature of 255 and a ~0 ms refresh mean the panel did not respond.
  Serial.printf("epd: full refresh %lu ms, panel temperature %d C\n", millis() - start, temp);
}

void epdShowPartial(const uint8_t *image) {
  // Same preamble as the vendor demo's partial update. The reset keeps the
  // controller's image RAM, so 0x26 still holds the previous page.
  hardwareReset();
  writeCommand(0x18);  // internal temperature sensor
  writeData(0x80);
  writeCommand(0x3C);  // border: keep as is
  writeData(0x80);
  setFullWindow();
  writeImage(0x24, image);

  writeCommand(0x22);  // partial update (panel's built-in waveform)
  writeData(0xFF);
  writeCommand(0x20);
  uint32_t start = millis();
  waitWhileBusy("partial refresh");
  Serial.printf("epd: partial refresh %lu ms\n", millis() - start);

  // Now on screen: store it as the "previous" image for the next update.
  setFullWindow();
  writeImage(0x26, image);
}

void epdSleep() {
  writeCommand(0x10);  // deep sleep; only a hardware reset wakes it
  writeData(0x01);
  delay(100);
}
